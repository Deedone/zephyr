## boards/arm64/rpi_5/Kconfig.defconfig
```kconfig
# Copyright 2023 honglin leng <a909204013@gmail.com>
# SPDX-License-Identifier: Apache-2.0

if BOARD_RPI_5

config BOARD
	default "Raspberry Pi 5"

endif # BOARD_RPI_5

if BOARD_RPI_5_XEN_DOM0

config BOARD
	default "Raspberry Pi 5 Xen Dom0"

config XEN_DOM0
	default y

endif # BOARD_RPI_5_XEN_DOM0
```

## boards/arm64/rpi_5/rpi_5_xen_dom0_defconfig
```kconfig
# Copyright (C) 2024 EPAM Systems.
# SPDX-License-Identifier: Apache-2.0

CONFIG_SOC_BCM2712=y
CONFIG_BOARD_RPI_5_XEN_DOM0=y
CONFIG_ARM64_VA_BITS_40=y
CONFIG_ARM64_PA_BITS_40=y
CONFIG_TIMER_READS_ITS_FREQUENCY_AT_RUNTIME=y

# Enable serial console.
CONFIG_SERIAL=y
CONFIG_CONSOLE=y
CONFIG_UART_CONSOLE=y
CONFIG_UART_INTERRUPT_DRIVEN=n

CONFIG_XEN_REGIONS=y
CONFIG_XEN_GRANT_TABLE=y
CONFIG_COMMON_LIBC_MALLOC=y
CONFIG_XEN_EVENTS=y
```

## soc/arm64/renesas_rcar/gen4/Kconfig.defconfig.r8a779f0
```kconfig
# Copyright (c) 2023 EPAM Systems
# SPDX-License-Identifier: Apache-2.0

if SOC_ARM64_R8A779F0

config SOC
	default "r8a779f0"

endif # SOC_ARM64_R8A779F0
```
